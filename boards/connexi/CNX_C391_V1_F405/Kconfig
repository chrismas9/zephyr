## boards/connexi/CNX_C391_V1_F405/Kconfig
```kconfig
# Connexi CNX-C391-V1_F405 board configuration

# Copyright (c) 2025 In Chip Design (Aust) P/L.
# SPDX-License-Identifier: Apache-2.0

if BOARD_CNX_C391_V1_F405

config BOARD_SERIAL_BACKEND_CDC_ACM
	bool "USB CDC console"
	default y

endif # BOARD_CNX_C391_V1_F405
```

## boards/connexi/CNX_C391_V1_F405/Kconfig.CNX_C391_V1_F405
```kconfig
# Copyright (c) 2017 Linaro Limited
# SPDX-License-Identifier: Apache-2.0

config BOARD_CNX_C391_V1_F405
	select SOC_STM32F405XX
```

## boards/connexi/CNX_C391_V1_F405/board.yml
```yaml
board:
  name: CNX_C391_V1_F405
  full_name: Connexi CNX F405
  vendor: Connexi
  socs:
    - name: stm32f405xx
```

## boards/connexi/CNX_C391_V1_L496/CNX_C391_V1_L496_defconfig
```kconfig
# SPDX-License-Identifier: Apache-2.0

# enable uart driver
CONFIG_SERIAL=y
CONFIG_UART_INTERRUPT_DRIVEN=y

# enable GPIO
CONFIG_GPIO=y

# enable I2C
CONFIG_I2C=y

# enable SPI
CONFIG_SPI=y

# enable CAN
CONFIG_CAN=y

# enable RTC
CONFIG_RTC=y

# enable ADC
CONFIG_ADC=y

# enable DAC
CONFIG_DAC=y

# enable clock
CONFIG_CLOCK_CONTROL=y

# console
CONFIG_CONSOLE=y
CONFIG_UART_CONSOLE=y

# enable MPU
CONFIG_ARM_MPU=y

# Enable HW stack protection
CONFIG_HW_STACK_PROTECTION=y

# enable pin controller
CONFIG_PINCTRL=y
```

## boards/connexi/CNX_C391_V1_L496/Kconfig.CNX_C391_V1_L496
```kconfig
# Copyright (c) 2017 Linaro Limited
# SPDX-License-Identifier: Apache-2.0

config BOARD_CNX_C391_V1_L496
	select SOC_STM32L496XX
```

## boards/connexi/CNX_C391_V1_L496/Kconfig.defconfig
```kconfig
# Connexi CNX-C391-V1_L496 board configuration

# Copyright (c) 2024 STMicroelectronics
# Copyright (c) 2025 In Chip Design (Aust) P/L.
# SPDX-License-Identifier: Apache-2.0

if BOARD_CNX_C391_V1_L496

config SPI_STM32_INTERRUPT
	default y
	depends on SPI

if BOARD_SERIAL_BACKEND_CDC_ACM

config USB_DEVICE_STACK
	default y

config USB_CDC_ACM
	default SERIAL

config USB_DEVICE_INITIALIZE_AT_BOOT
	default y if CONSOLE

config SHELL_BACKEND_SERIAL_CHECK_DTR
	default SHELL
	depends on UART_LINE_CTRL

config UART_LINE_CTRL
	default SHELL

config USB_DEVICE_REMOTE_WAKEUP
	default n

config USB_DEVICE_VID
	default 0x0483

config USB_DEVICE_PID
	default 0x5740

config USB_DEVICE_PRODUCT
	default "Zephyr CDC CNX-C391-V1_L496"

if LOG

# Logger cannot use itself to log
choice USB_CDC_ACM_LOG_LEVEL_CHOICE
	default USB_CDC_ACM_LOG_LEVEL_OFF
endchoice

endif # LOG

endif # BOARD_SERIAL_BACKEND_CDC_ACM

endif # BOARD_CNX_C391_V1_L496
```

## boards/connexi/CNX_C391_V1_L496/board.yml
```yaml
board:
  name: CNX_C391_V1_L496
  full_name: Connexi CNX L496
  vendor: Connexi
  socs:
    - name: stm32L496xx
```
